## components/Kconfig
```kconfig
menu "Components"

config CONFIG_PREBUILT_SUBDIR
	string "Prebuilt subdir"
source "prebuilts/Kconfig"

source "applications/Kconfig"
source "libssp/Kconfig"
source "newlib/Kconfig"
source "kernel/Kconfig"
source "cmds/Kconfig"
source "pthread/Kconfig"
source "ffmpeg/Kconfig"
source "hc-examples/Kconfig"
source "opencore-amr/Kconfig"
source "libusb/Kconfig"
source "libuvc/Kconfig"
source "libuac/Kconfig"
source "hcfota/Kconfig"
source "liblvgl/Kconfig"
source "bluetooth/Kconfig"
source "quicklz/Kconfig"
source "liblzo/Kconfig"
source "zlib/Kconfig"
source "libopenssl/Kconfig"
source "mbedtls/Kconfig"
source "cjson/Kconfig"
source "hccast/Kconfig"
source "libcurl/Kconfig"
source "unity/Kconfig"
source "memtester/Kconfig"
source "freetype/Kconfig"
source "pcre/Kconfig"
source "speex/Kconfig"
source "libev/Kconfig"
source "wolfssl/Kconfig"
source "opus/Kconfig"
source "hudi/Kconfig"
source "libwebsockets/Kconfig"
source "hctinyplayer-registry/Kconfig"

menu "Host utilities"
source "dtc/Config.in.host"
source "uboot-tools/Config.in.host"
source "lzo1x/Config.in.host"
source "m4/Config.in.host"
source "libtool/Config.in.host"
source "automake/Config.in.host"
source "autoconf/Config.in.host"
endmenu

source "hclib/Kconfig"
source "sqlite/Kconfig"

endmenu
```

## components/applications/Kconfig
```kconfig
menu "Applications Configuration"

config CONFIG_APPS_NAME
	string
	default "avp" if BR2_PACKAGE_APPS_AVP
	default "hcboot" if BR2_PACKAGE_APPS_BOOTLOADER
	default "hcboot" if BR2_PACKAGE_APPS_MINIBOOT
	default "hdmiswitch" if BR2_PACKAGE_APPS_HDMISWITCH
	default "projector" if BR2_PACKAGE_APPS_PROJECTOR
	default "hcscreen" if BR2_PACKAGE_APPS_HCSCREEN
	default "spinandwr" if BR2_PACKAGE_APPS_SPINANDWR
	default "b2bupdater" if BR2_PACKAGE_APPS_B2BUPDATER
	default "hcusbcast" if BR2_PACKAGE_APPS_HCUSBCAST
	default "boardtest" if BR2_PACKAGE_APPS_BOARDTEST
	default "hcscreenhybrid" if BR2_PACKAGE_APPS_HCSCREENHYBRID
	default "hctinyplayer" if BR2_PACKAGE_APPS_HCTINYPLAYER
	default "hcrtosapp"
	
config CONFIG_APP_HOSTNAME
	string "hostname"
	default "hichip"

config CONFIG_APP_TIMEZONE
	string "timezone"
	default "GMT-8"

config CONFIG_APP_LOG_LEVEL
	int "log level 0-5"
	default "5"

menu "Application Selection"

comment "Please select only ONE application!"
comment "Select multi-applications will cause un-expected result!"

source "apps-avp/Kconfig"
source "apps-bootloader/Kconfig"
source "apps-miniboot/Kconfig"
source "apps-hdmiswitch/Kconfig"
source "apps-projector/Kconfig"
source "apps-hcscreen/Kconfig"
source "apps-spinandwr/Kconfig"
source "apps-b2bupdater/Kconfig"
source "apps-kidev/Kconfig"
source "apps-hcusbcast/Kconfig"
source "apps-xbmp5/Kconfig"
source "apps-boardtest/Kconfig"
source "apps-hcscreenhybrid/Kconfig"
source "apps-cubemp5/Kconfig"
source "apps-hctinyplayer/Kconfig"
source "apps-projector-hudi/Kconfig"

endmenu
endmenu
```

## components/applications/apps-boardtest/Kconfig
```kconfig
menuconfig BR2_PACKAGE_APPS_BOARDTEST
	bool "boardtest"

if BR2_PACKAGE_APPS_BOARDTEST
source "source/Kconfig"
endif
```

## components/applications/apps-bootloader/source/Kconfig
```kconfig
menuconfig CONFIG_BOOT_SELFCOMPRESSED
	bool "Support bootloader self compressed"
	default n

if CONFIG_BOOT_SELFCOMPRESSED

choice
	prompt "Bootloader self compress algo"
	default CONFIG_BOOT_SELFCOMPRESSED_LZMA

	config CONFIG_BOOT_SELFCOMPRESSED_LZMA
		bool "Bootloader lzma self-compressed"

	config CONFIG_BOOT_SELFCOMPRESSED_LZO1X
		bool "Bootloader lzo1x self-compressed"

	config CONFIG_BOOT_SELFCOMPRESSED_GZIP
		bool "Bootloader gzip self-compressed"
endchoice

endif

config CONFIG_BOOT_KEYSTONE
	bool "Support boot keystone"
	depends on CONFIG_SOC_HC16XX
	select CONFIG_KSC_SUPPORT
	help
	  Bootloader support keystone

config CONFIG_BOOT_SHOWLOGO
	bool "Support boot show logo/av"
	default y
	help
	  This feature depends on audio/video driver support in hcrtos kernel.
	  If the is no audio/video driver enabled, the audio or video or both
	  will be ignored.

config CONFIG_BOOT_OSDLOGO
	bool "Support boot show bmp logo on OSD"
	default n
	help
	  This feature depends on audio/video driver support in hcrtos kernel.
	  If the is no audio/video driver enabled, the audio or video or both
	  will be ignored.

config CONFIG_BOOT_ZOOM
	bool "Support boot logo zoom"
	default n

config CONFIG_BOOT_HDMI_TX_CHECK_EDID
	bool "Support edid detection"
	default n
	help
	  edid detection

choice
	prompt "Firmware Solution"
	default CONFIG_BOOT_HCRTOS

	config CONFIG_BOOT_HCRTOS
		bool "Boot hcrtos firmware"

	config CONFIG_BOOT_HCLINUX_DUALCORE
		bool "Boot hclinux dual-core firmware"

	config CONFIG_BOOT_HCLINUX_SINGLECORE
		bool "Boot hclinux single-core firmware"

	config CONFIG_BOOT_HCRTOS_OR_HCRTOS
		bool "Boot hcrtos(Primary) or hcrtos(Secondary) firmware"

	config CONFIG_BOOT_HCRTOS_OR_HCLINUX_DUALCORE
		bool "Boot hcrtos(Primary) or hclinux dual core(Secondary) firmware"

	config CONFIG_BOOT_HCLINUX_DUALCORE_OR_HCRTOS
		bool "Boot hclinux dual core(Primary) or hcrtos(Secondary) firmware"

	config CONFIG_BOOT_HCLINUX_DUALCORE_OR_HCLINUX_DUALCORE
		bool "Boot hclinux dual core(Primary) or hclinux(Secondary) firmware"

	config CONFIG_BOOT_NONE
		bool "No firmware to boot"
endchoice

config CONFIG_BOOT_UPDATE_SCREEN_PARAMS
	bool "Support boot update screen parameters"
	default n
	depends on CONFIG_BOOT_HCLINUX_DUALCORE || CONFIG_BOOT_HCRTOS_OR_HCLINUX_DUALCORE || CONFIG_BOOT_HCLINUX_DUALCORE_OR_HCRTOS || CONFIG_BOOT_HCLINUX_DUALCORE_OR_HCLINUX_DUALCORE
	help
	  Support boot update screen parameters in bootloader

config CONFIG_BOOT_SHOWMEMINFO
	bool "Support show memory info"
	default y
	help
	  Show memory info in console

menuconfig CONFIG_BOOT_UPGRADE
	bool "Support upgrade"
	select BR2_PACKAGE_HCFOTA
	default y
	help
	  Support upgrade in bootloader

if CONFIG_BOOT_UPGRADE
config CONFIG_BOOT_AUTO_UPGRADE
	bool "use auto upgrade in bootloader(usb disk / sd-card)"
	default n

config CONFIG_BOOT_UPGRADE_SUPPORT_USBDEVICE
	bool "Support upgrade via USB device mode"
	select CONFIG_DRVR_RAMDISK
	select BR2_PACKAGE_PREBUILTS_USBGADGETDRIVER
	default n

config CONFIG_BOOT_UPGRADE_SUPPORT_USBHOST
	bool "Support upgrade from U-Disk"
	default n

if CONFIG_BOOT_UPGRADE_SUPPORT_USBHOST
config CONFIG_BOOT_UPGRADE_SUPPORT_USBHOST_DETECT_TIMEOUT
	int "USB Host Timeout to detect U-Disk"
	range 0 60000
	default 1000
endif

config CONFIG_BOOT_UPGRADE_SUPPORT_SD
	bool "Support upgrade from SD-Card"
	default n

config CONFIG_BOOT_UPGRADE_SUPPORT_NETWORK
	bool "Support upgrade from network"
	default n

config CONFIG_BOOT_UPGRADE_SHOW_WITH_SCREEN
	bool "Show upgrade progress on screen"
	select CONFIG_MMAP
	select CONFIG_DRV_VIDEO
	select CONFIG_DRV_HCFB
	default n

config CONFIG_BOOT_UPGRADE_SHOW_WITH_SERIAL
	bool "Show upgrade progress on serial stdio"
	default y

config CONFIG_BOOT_UPGRADE_SHOW_WITH_LED
	bool "Show upgrade progress with LED blinking"
	default n
endif

config CONFIG_BOOT_HCFOTA_TIMEOUT
	int "Timeout to detect HCFOTA.bin in U-Disk/SD"
	depends on CONFIG_BOOT_UPGRADE_SUPPORT_USBHOST || CONFIG_BOOT_UPGRADE_SUPPORT_SD
	range 0 60000
	default 10000

config CONFIG_BOOT_USBD_UPGRADE_REQUEST_TIME
	int "usbd upgrade request time "
	depends on CONFIG_BOOT_UPGRADE_SUPPORT_USBDEVICE
	range 0 5
	default 3

config CONFIG_BOOT_USBD_UPGRADE_USBD_PORT_NUM
	int "select which port to usbd upgrade"
	depends on CONFIG_BOOT_UPGRADE_SUPPORT_USBDEVICE
	range 0 1
	default 0

menuconfig CONFIG_BOOT_STANDBY
	bool "Support boot standby"
	default n
	select CONFIG_DRV_INPUT
	select CONFIG_DRV_STANDBY
	help
	  This function depends on the standby function in the hcrtos kernel.
	  If the standby function is not enabled, the function cannot take effect.

if CONFIG_BOOT_STANDBY
config CONFIG_BOOT_STANDBY_DELAY_TIME
	int "Delay before entering standby, in milliseconds"
	range 0 10000
	default 0
endif

menuconfig CONFIG_BOOT_BACKLIGHT
	bool "Support boot open lcd backlight"
	default y
	select BR2_PACKAGE_HUDI
	select BR2_PACKAGE_HUDI_SCREEN
	help
		open lcd backlight

if CONFIG_BOOT_BACKLIGHT
config CONFIG_BOOT_BACKLIGHT_DELAY_TIME
	int "Time for boot to turn on backlight, in milliseconds"
	range 0 10000
	default 0

config CONFIG_BOOT_PWM_BACKLIGHT_MONITOR
	bool "Backlight monitor function"
	default n
	help
	  add backlight detection function

config CONFIG_BOOT_BLUETOOTH_BACKLIGHT
	bool "Bluetooth open gpio backlight"
	default n
	help
	  Set bluetooth open gpio backlight

config CONFIG_BOOT_SYSDATA_SET_BACKLIGHT_VALUE
	bool "backlight set sysdata lcd_pwm backlight"
	default n
	help
	  Set sysdata lcd_pwm_backlight value
endif

config CONFIG_BOOT_PQ_START
	bool "Support boot open pq start"
	default n
	depends on CONFIG_SOC_HC16XX
	help
	  open pq start

menuconfig CONFIG_BOOT_LCD
	bool "Support boot open lcd"
	default y
	help
	  Open lcddev for lcddev initialization

if CONFIG_BOOT_LCD
config CONFIG_BOOT_LCD_ROTATE
	bool "Support lcd rotate"
	default n
	select CONFIG_DRV_LCD
	select CONFIG_DRV_LCD_DEV
	help
		open lcd rotate
endif

config CONFIG_BOOT_SUPPORT_POPUP
	bool "Support popup while waiting for USB/SD-card"
	default n

menuconfig CONFIG_BOOT_SUPPORT_BATTERY_CHECK
	bool "Support battery level check"
	default n
	help
		Battery level detection, does not start when the battery level is low

if CONFIG_BOOT_SUPPORT_BATTERY_CHECK
choice
	prompt "Battery Partnumber"
	default CONFIG_BOOT_SUPPORT_BATTERY_CHECK_C6P2

config CONFIG_BOOT_SUPPORT_BATTERY_CHECK_C6P2
	bool "Cubemp5 c6 p2"
	help
		Supprot cubemp5 c6 p2 battery check
endchoice
endif
```

## components/applications/apps-cubemp5/Kconfig
```kconfig
menuconfig BR2_PACKAGE_APPS_CUBEMP5
	bool "cubemp5"
	select BR2_PACKAGE_PREBUILTS_LIBGE
	select BR2_PACKAGE_LIBLVGL
	select BR2_PACKAGE_PREBUILTS_LIBLRBALANCE
	select BR2_PACKAGE_PREBUILTS_LIBTWOTONE
	select BR2_PACKAGE_PREBUILTS_SPECTRUM

if BR2_PACKAGE_APPS_CUBEMP5

config CONFIG_APPS_PROJECTOR_HDMIIN
	bool "Enable HDMI IN"
	default y
	select BR2_PACKAGE_PREBUILTS_HDMIRX	

config CONFIG_APPS_PROJECTOR_CVBSIN
	bool "Enable CVBS IN"
	default y
	select CONFIG_VIDEO_TVDECODER_SUPPORT

config CONFIG_APPS_PROJECTOR_CVBS_TRAINING
	bool "Enable CVBS training"
	default n
	depends on CONFIG_APPS_PROJECTOR_CVBSIN
	select BR2_PACKAGE_HUDI
	select BR2_PACKAGE_HUDI_FLASH
	
config CONFIG_APPS_PROJECTOR_USBMIRROR
	bool "Enable USBMirror"
	default n
	select CONFIG_NET
	select BR2_PACKAGE_LIBUSB
	select BR2_PACKAGE_HCCAST
	select BR2_PACKAGE_HCCAST_USBMIRROR

config CONFIG_APPS_PROJECTOR_WIRELESSCAST
	bool "Enable WirelessCast(miracast/dlna/airmirror)"
	default n
	select BR2_PACKAGE_HCCAST		
	select CONFIG_NET
	select BR2_PACKAGE_CJSON
	select BR2_PACKAGE_PREBUILTS_LIBDSC
	#select BR2_PACKAGE_PREBUILTS_RTL8188FU
	select BR2_PACKAGE_PREBUILTS_WPA_SUPPLICANT
	select BR2_PACKAGE_PREBUILTS_WIFI_WIRELESS_TOOLS
	select BR2_PACKAGE_LIBUSB 
	select BR2_PACKAGE_PREBUILTS_AACELDEC 
	select BR2_PACKAGE_HCCAST_WIRELESS 

if CONFIG_APPS_PROJECTOR_WIRELESSCAST	

config CONFIG_APPS_PROJECTOR_AIRP2P
	bool "Enable Airp2p"
	default n
	select BR2_PACKAGE_HCCAST_AIRP2P_SUPPORT
	select BR2_PACKAGE_LIBUSB

endif
	
config CONFIG_APPS_PROJECTOR_BLUETOOTH
	bool "Enable Bluetooth"
	default n
	depends on BR2_PACKAGE_BLUETOOTH
	help
		open BT according to your board used.
config CONFIG_APPS_PROJECTOR_VMOTOR_DRIVE
	bool "Support projector vmotor drive"
	default n
	help
		open step motor drive.

config CONFIG_APPS_PROJECTOR_SPDIF_OUT
	bool "Support projector spdif out"
	default n
	help
		open spdif out.

config CONFIG_APPS_PROJECTOR_SYS_ZOOM
	bool "Enable system zoom"
	default n 
	help
		open sys zoom

config CONFIG_APPS_PROJECTOR_USB_AUTO_UPGRADE
	bool "Enable usb auto upgrade"
	default n 
	help
		open open usb auto upgrade

config CONFIG_APPS_PROJECTOR_MAIN_PAGE
	bool "Support Main(home) page"
	default y
	help
		open main page.

config CONFIG_APPS_PROJECTOR_CVBS_AUDIO_I2SI_I2SO
	bool "Support projector cvbs audio i2si i2so"
	default y
	help
		set cvbs audio i2si i2so out.
		
config CONFIG_APPS_PROJECTOR_CAST_720P
	bool "Support 720p cast"
	default n
	help
		720p cast in 64M solution.

config CONFIG_APPS_PROJECTOR_BACKLIGHT_MONITOR
	bool "support backlight monitor"
	default n
	help
		support backlight monitor.

config CONFIG_APPS_PROJECTOR_KEYSTONE
	bool "support keystone"
	default n
	depends on CONFIG_SOC_HC16XX
	help
		support projector keystone function.

config CONFIG_APPS_PROJECTOR_LVGL_RESOLUTION_240P
    	bool "Support LVGL(osd) resolution for 240P"
    	default n
     	help
        reset LVGL resolution for 320 *240.

config CONFIG_APPS_PROJECTOR_LVGL_MBOX_STANDBY
	bool "Press POWER 2 times enter standby?"
	default n
	help
		Support confirm when you go in standby

config CONFIG_APPS_PROJECTOR_HCIPTV_YTB
	bool "Support HCIPTV YTB Function"
	default n
	select BR2_PACKAGE_PREBUILTS_LIBYOUTUBE
	help
		Support HCIPTV YTB IN PROJECTOR APPS

config CONFIG_APPS_PROJECTOR_MULTI_OS
	bool "Enable Multi_OS"
	default n

config CONFIG_AUTO_HTTP_UPGRADE
	bool "Enable auto http upgrade"
	default n

config CONFIG_MANUAL_HTTP_UPGRADE
	bool "Enable manual http upgrade"
	default n

config CONFIG_HTTP_UPGRADE_URL
	string "http upgrade url"
	default "http://172.16.12.81:80"

config CONFIG_APPS_USB_MIRROR_FAST_MODE
	bool "Support switch to usb mirror playing in main page or other menus"
	depends on BR2_PACKAGE_HCCAST_USBMIRROR
	default n

config CONFIG_APPS_IMAGE_DISPLAY_MODE_CHANGE
	bool "Enable change image display mode(realsize, full,etc) in playbar"
	default n

config CONFIG_APPS_TRANSCODE_THUMBNIAL_SHOW
	bool "Enable image tanscode thumbnail showed in media list"
	default n

config CONFIG_APPS_MEDIA_MEMORY_PLAY
	bool "Support media memory play"
	default n
	help
		while play the former media again, it would play last position.

config CONFIG_APPS_PROJECTOR_FACTORY_SET
	bool "Enable HC FACTORY SETTING"
	default y

config CONFIG_APPS_PROJECTOR_HDMI_SWITCH_SUPPORT
	bool "support hdmi switch(ms9601a)"
	default n

menuconfig CONFIG_APPS_PROJECTOR_BATTERY_MONITOR
	bool "Enable Battery Monitor"
	default n
	select CONFIG_I2C_GPIO_MASTER

if CONFIG_APPS_PROJECTOR_BATTERY_MONITOR
config CONFIG_I2C_GPIO_MASTER
	bool "I2C GPIO Master"
	default n
endif

config CONFIG_APPS_BLUETOOTH_SPEAKER_MODE_SUPPORT
	bool "Support Bluetooth Speaker Mode Set"
	default n
    help
		Support Bluetooth Speaker Mode Set for Ac6956cgx .

config CONFIG_APPS_LCD_ROTATE
	bool "Support lcd rotate"
	default n
	select CONFIG_DRV_LCD
	select CONFIG_DRV_LCD_DEV
	help
		Support lcd rotate

menuconfig CONFIG_APP_DRC_GAIN
	bool "Enable DRC Gain"
	default n
	select BR2_PACKAGE_PREBUILTS_DRC

if CONFIG_APP_DRC_GAIN
config CONFIG_APP_DRC_GAIN_LEVEL
	int "DRC Gain Level 0-30"
	default "12"
	help
		set DRC gain
endif

endif
```

## components/applications/apps-hcscreen/source/Kconfig
```kconfig
if (BR2_PACKAGE_APPS_HCSCREEN)

if (BR2_PACKAGE_PREBUILTS_TOE || BR2_PACKAGE_PREBUILTS_TOE2)

config CONFIG_HOTSPOT
	bool "Support net hotspot"
	default n
	select CONFIG_NET_HOTSPOT

endif

config CONFIG_HTTP_UPGRADE_URL
	string "http upgrade url"
	default "http://172.16.12.81:80"

config CONFIG_APPS_AIRP2P
	bool "Enable Airp2p"
	default n
	select BR2_PACKAGE_HCCAST_AIRP2P_SUPPORT
	select BR2_PACKAGE_LIBUSB

config CONFIG_APPS_WATCHDOG_SUPPORT
	bool "Enable watchdog"
	depends on CONFIG_DRV_WDT
	default y

config CONFIG_APPS_WATCHDOG_TIMEOUT
	int "Default timeout (in millisecond) of watchdog timer"
	depends on CONFIG_APPS_WATCHDOG_SUPPORT
	range 1 120000
	default 30000

config CONFIG_APPS_UIBC_SUPPORT
	bool "Support UIBC"
	default n
	select BR2_PACKAGE_PREBUILTS_USBDRIVER_HID
	help
		Support UIBC For APPS

endif
```
