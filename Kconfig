## components/applications/apps-hcscreenhybrid/Kconfig
```kconfig
menuconfig BR2_PACKAGE_APPS_HCSCREENHYBRID
	bool "hcscreenhybrid"
	select BR2_PACKAGE_PREBUILTS_LIBGE
	select BR2_PACKAGE_LIBLVGL
	select BR2_PACKAGE_HCFOTA
	select BR2_PACKAGE_HCCAST
	select BR2_PACKAGE_HUDI

if BR2_PACKAGE_APPS_HCSCREENHYBRID
source "source/Kconfig"
endif
```

## components/applications/apps-hctinyplayer/Kconfig
```kconfig
menuconfig BR2_PACKAGE_APPS_HCTINYPLAYER
	bool "hctinyplayer"

if BR2_PACKAGE_APPS_HCTINYPLAYER
source "source/Kconfig"
endif
```

## components/applications/apps-hcusbcast/source/Kconfig
```kconfig
if BR2_PACKAGE_APPS_HCUSBCAST

config CONFIG_APPS_IUM
	bool "ium"
	default y
	select CONFIG_NET
	
config CONFIG_APPS_AUM
	bool "aum"
	default y

config CONFIG_APPS_HCUSBCAST_HID
	bool "back control hid"
	select BR2_PACKAGE_PREBUILTS_LIBHIDALGO
	default n

endif
```

## components/applications/apps-miniboot/Kconfig
```kconfig
menuconfig BR2_PACKAGE_APPS_MINIBOOT
	bool "mini bootloader"
	default n

if BR2_PACKAGE_APPS_MINIBOOT
source "source/Kconfig"
endif
```

## components/applications/apps-miniboot/source/Kconfig
```kconfig
menuconfig CONFIG_MINIBOOT_SELFCOMPRESSED
	bool "Support Miniboot self compressed"
	default n

if CONFIG_MINIBOOT_SELFCOMPRESSED

choice
	prompt "Miniboot self compress algo"
	default CONFIG_MINIBOOT_SELFCOMPRESSED_LZMA

	config CONFIG_MINIBOOT_SELFCOMPRESSED_LZMA
		bool "Miniboot lzma self-compressed"

	config CONFIG_MINIBOOT_SELFCOMPRESSED_LZO1X
		bool "Miniboot lzo1x self-compressed"

	config CONFIG_MINIBOOT_SELFCOMPRESSED_GZIP
		bool "Bootloader gzip self-compressed"
endchoice

endif

choice
	prompt "Firmware Solution"
	default CONFIG_MINIBOOT_HCRTOS

	config CONFIG_MINIBOOT_HCRTOS
		bool "Boot hcrtos firmware"

	config CONFIG_MINIBOOT_HCLINUX_SINGLECORE
		bool "Boot hclinux single-core firmware"

	config CONFIG_MINIBOOT_NONE
		bool "No firmware to boot"
endchoice

config CONFIG_MINIBOOT_SHOWMEMINFO
	bool "Support show memory info"
	default y
	help
	  Show memory info in console

config CONFIG_MINIBOOT_CUSTOM_DTS_PATH
	string "Device Tree Source file paths"
	help
	  Space-separated list of paths to device tree source files
	  that will be used to generated dtb file.

config CONFIG_MINIBOOT_DEFAULT_DEVICE_TREE
	string "Default Device Tree"
	help
	  The generated DTB filename that will be installed into
	  $(IMAGES_DIR). The kernel will include it from $(IMAGES_DIR)
	  as embedded data if CONFIG_OF_EMBED is enabled.

config CONFIG_MINIBOOT_LIB_LZMA
	bool "LZMA decompress support"
	default n

config CONFIG_MINIBOOT_LIB_GZIP
	bool "GZIP decompress support"
	select BR2_PACKAGE_ZLIB
	default n

config CONFIG_MINIBOOT_DISABLE_LOG
	bool "Disable log"
	default n
	help
	  Disable log in miniboot
```

## components/applications/apps-projector/Kconfig
```kconfig
menuconfig BR2_PACKAGE_APPS_PROJECTOR
	bool "projector"
	select BR2_PACKAGE_PREBUILTS_LIBGE
	select BR2_PACKAGE_LIBLVGL
	select BR2_PACKAGE_PREBUILTS_LIBLRBALANCE
	select BR2_PACKAGE_PREBUILTS_LIBTWOTONE
	select BR2_PACKAGE_PREBUILTS_SPECTRUM
	select BR2_PACKAGE_HUDI
	select BR2_PACKAGE_HUDI_SCREEN

if BR2_PACKAGE_APPS_PROJECTOR
source "source/Kconfig"
endif
```

## components/bluetooth/Kconfig
```kconfig
menuconfig BR2_PACKAGE_BLUETOOTH
	bool "Bluetooth"
	default n

if BR2_PACKAGE_BLUETOOTH
choice
	prompt "Bluetooth Partnumber"
	default BR2_PACKAGE_AD6956F
config BR2_PACKAGE_NULLBT
	bool "None"
	help
		No specific module
config BR2_PACKAGE_AD6956F
	bool "AD6956F"
	help
		Bluetooth ad6956f module api
config BR2_PACKAGE_AC6955F
	bool "AC6955F Set"
	help
		Bluetooth ac6955f module api
endchoice

if BR2_PACKAGE_AC6955F
choice
	prompt "AC6955F"
	default BR2_PACKAGE_AC6955F_RT
config BR2_PACKAGE_AC6955F_RT
	bool "AC6955F RT"
	help
		Bluetooth ac6955f module api

config BR2_PACKAGE_AC6955F_GX
	bool "AC6955F GX"
	help
		Bluetooth ac6955f gx module api

config BR2_PACKAGE_AC6956C_GX
	bool "AC6956C GX"
	help
		Bluetooth AC6956C gx module api
endchoice
endif

endif
```

## components/cmds/source/Kconfig
```kconfig
menuconfig CONFIG_CMDS_OS
	bool "OS operations"
	default n

if CONFIG_CMDS_OS
source "os/Kconfig"
endif

config CONFIG_CMDS_PTHREAD
	bool "pthread operations"
	depends on BR2_PACKAGE_PTHREAD
	default n

menuconfig CONFIG_CMDS_NSH
	bool "Nsh operations"
	default n

if CONFIG_CMDS_NSH
source "third_party/nuttx/apps/nshlib/Kconfig"
endif

menuconfig CONFIG_CMDS_SOUND_TEST
	bool "sound test operations"
	default n

if CONFIG_CMDS_SOUND_TEST
source "sound_test/Kconfig"
endif

config CONFIG_CMDS_LSMOD
	bool "lsmod operations"
	default y

menuconfig CONFIG_CMDS_ADC_TEST
	bool "adc test operations"
	default n

if CONFIG_CMDS_ADC_TEST
source "saradc/Kconfig"
endif

config CONFIG_CMDS_FB_TEST
	bool "fb test operations"
	default n

config CONFIG_CMDS_INPUT
	bool "input event operations"
	depends on CONFIG_DRV_INPUT
	default n

if CONFIG_CMDS_INPUT
source "input_event/Kconfig"
endif

config CONFIG_CMDS_MTD
	bool "mtd operations"
	depends on CONFIG_MTD
	default n

config CONFIG_CMDS_SPI
	bool "spi operations"
	depends on CONFIG_HC_SPI_SF || CONFIG_HC_SPI_MASTER
	default n

if CONFIG_CMDS_SPI
	choice
        prompt "Test spi controller"
	default TEST_SPI_SF

        config TEST_SPI_SF
                bool "test spi-sf"
        config TEST_SPI_MASTER
                bool "test spi-master"
	config TEST_SPI_GPIO
		bool "test spi-gpio"

	endchoice

source "spi/Kconfig"
endif


config CONFIG_CMDS_PERSISTENTMEM
	bool "persistent memory operations"
	depends on CONFIG_DRV_PERSISTENTMEM
	default n

config CONFIG_CMDS_POK_TEST
	bool "pok test operations"
	default n

config CONFIG_CMD_UART
	bool "uart test operations"
	default n

config CONFIG_CMDS_WATCHDOG_TEST
	bool "watchdog test operations"
	default n

config CONFIG_CMDS_EFUSE_DUMP
	bool "Efuse bits dump operations"
	default n

config CONFIG_CMDS_PQ
	bool "PQ test operations"
	default n

config CONFIG_CMDS_DIS
	bool "Display debugging"
	default n

config CONFIG_CMDS_HCFOTA
	bool "HCFOTA test operations"
	select BR2_PACKAGE_HCFOTA
	default n

config CONFIG_CMDS_STANDBY
	bool "standby test operations"
	default n

config CONFIG_CMDS_RTWPRIV
	bool "config rtwpriv"
	default n

config CONFIG_CMDS_IPERF3
	bool "config iperf3"
	default n

config CONFIG_CMDS_WS2811
	bool "ws2811 test operations"
	select BR2_PACKAGE_PREBUILTS_LIBWS2811
	default n

config CONFIG_CMDS_SORTING
       bool "sorting test operations"
       select BR2_PACKAGE_PREBUILTS_LIBSORTING
       default n

if CONFIG_CMDS_SORTING
source "sorting/Kconfig"
endif

menuconfig CONFIG_CMDS_USB
	bool "USB setting operations"
	default n

if CONFIG_CMDS_USB
source "usb/Kconfig"
endif

config CONFIG_CMDS_VIN_DVP
bool "vin dvp test operations"
default n

config CONFIG_CMDS_PWM
bool "pwm test"
default n

config CONFIG_CMDS_WIFI
	bool "wifi test"
	select BR2_PACKAGE_PREBUILTS_WIFI_WIRELESS_TOOLS
	default n

if CONFIG_CMDS_WIFI
config CONFIG_CMDS_UPDATE_MAC_ADDR
	bool "wifi mac addr updating test"
	default n
endif

config CONFIG_CMD_NETWORK
	bool "Network test commands"
	default n
	depends on BR2_PACKAGE_LIBCURL

menuconfig CONFIG_CMD_UNITY
        bool "Unity test entry"
	depends on BR2_PACKAGE_UNITY
	default n

if CONFIG_CMD_UNITY
config CONFIG_CMD_UNITY_DUMMY_CASES
        bool "Dummy unity test cases"
	default n
endif

config CONFIG_CMDS_RTC_AT8536
	bool "rtc at8536 test operations"
	default n

menuconfig CONFIG_CMD_UPGRADE_5100
	bool "5100 upgrade"
	default n

if CONFIG_CMD_UPGRADE_5100
choice
        prompt "5100 upgarde mode"
        default CONFIG_5100_UART_UPGARDE

        config CONFIG_5100_UART_UPGARDE
                bool "uart mode"

        config CONFIG_5100_I2C_UPGARDE
                bool "i2c mode"
endchoice
endif

config CONFIG_CMD_LCD_TEST
	bool "lcd test"
	default n

config CONFIG_CMD_MKGPT
	bool "mkgpt"
	default n

config CONFIG_CMD_DDR_MONITORING
	bool "DDR usage monitoring"
	default n

config CONFIG_CMDS_SQLITE
	bool "sqlite test"
    select BR2_PACKAGE_SQLITE
	default n
```

## components/cmds/source/input_event/Kconfig
```kconfig
config CONFIG_CMDS_INPUT_POLL_TEST
	bool "input poll test"
	default n

config CONFIG_CMDS_INPUT_JOYSTICK_TEST
	bool "input joystick test"
	default n

config CONFIG_CMDS_INPUT_IOCTL_TEST
	bool "input ioctl test"
	default n
```

## components/cmds/source/sorting/Kconfig
```kconfig
choice
	prompt "Sorting ES mode"
        default CONFIG_SORTING_A3200

        config CONFIG_SORTING_A3200 
		bool "A3200"
        config CONFIG_SORTING_C3000
                bool "C3000"
	config CONFIG_SORTING_C5200
                bool "C5200"
        config CONFIG_SORTING_D3000
                bool "D3000"
        config CONFIG_SORTING_D5200
                bool "D5200"
	config CONFIG_SORTING_C3100
                bool "C3100"
	config CONFIG_SORTING_B3100
                bool "B3100"
endchoice
```

## components/cmds/source/sound_test/Kconfig
```kconfig
config CONFIG_CMDS_SOUND_I2SO
	bool "i2s out test"
	default n

config CONFIG_CMDS_SOUND_AUDSINK
	bool "audsink test"
	default n

config CONFIG_CMDS_SOUND_AUDDEC
	bool "auddec test"
	default n

config CONFIG_CMDS_SOUND_I2SI
	bool "i2s in test"
	default n

config CONFIG_CMDS_SOUND_TDMI
	bool "tdm in test"
	default n

config CONFIG_CMDS_SOUND_SPDIFIN
	bool "spdif in test"
	default n

config CONFIG_CMDS_SOUND_PDMI
	bool "PDM in in test"
	default n

config CONFIG_CMDS_SOUND_PCMI
	bool "PCM in in test"
	default n

config CONFIG_CMDS_SOUND_I2SI012
	bool "i2si-0/1/2 test"
	default n

config CONFIG_CMDS_SOUND_I2SO_TO_I2SI
	bool "i2so to i2si test"
	default n

config CONFIG_CMDS_SOUND_PCMI_TO_PCMO
	bool "pcmi to pcmo test"
	default n

config CONFIG_CMDS_SOUND_I2SI_TO_I2SO
	bool "i2si to i2so test"
	default n

config CONFIG_CMDS_SOUND_SPECTRUM
	bool "spectrum test"
	default n

config CONFIG_CMDS_SOUND_AEC
	bool "aec test"
	depends on BR2_PACKAGE_PREBUILTS_3A
	default n

config CONFIG_CMDS_SOUND_ALAC
	bool "alac decoder test"
	default n

config CONFIG_CMDS_SOUND_I2SI_TO_AUDDEC
	bool "i2si to auddec test"
	default n

config CONFIG_CMDS_SOUND_AUDDEC
	bool "auddec test"
	default n

config CONFIG_CMDS_SOUND_DRC
	bool "drc test"
	default n
```

## components/cmds/source/spi/Kconfig
```kconfig
menuconfig CONFIG_CMDS_FLASH_TEST
	bool "flash test cmd"
	default n

if CONFIG_CMDS_FLASH_TEST

config CONFIG_CMDS_FLASH_TORTURETEST
	bool "flash torture test operations"
	default n
endif

config CONFIG_CMDS_FLASH_LOCK_SAMPLE
	bool "flash lock sample"
	default n
```

## components/cmds/source/usb/Kconfig
```kconfig
config CONFIG_CMDS_FILE_TEST
	bool "USB file test"
	default n

config CONFIG_CMDS_LIBUSB_EXAMPLES
	bool "USB: libusb examples"
	depends on CONFIG_CMDS_USB
	depends on BR2_PACKAGE_LIBUSB
	default n

config CONFIG_CMDS_LIBUVC_EXAMPLES
	bool "USB: libuvc examples (examples for usb camera driver)"
	depends on CONFIG_CMDS_USB
	depends on BR2_PACKAGE_LIBUSB
	depends on BR2_PACKAGE_LIBUVC
	default n

config CONFIG_CMDS_LIBUAC_EXAMPLES
	bool "USB: libuac examples (examples for usb audio UAC driver)"
	depends on CONFIG_CMDS_USB
	depends on BR2_PACKAGE_LIBUSB
	depends on BR2_PACKAGE_LIBUAC
	default n

config CONFIG_CMDS_USB_EYE_PATTERN
	bool "USB: Oscilloscope test eye pattern"
	depends on CONFIG_CMDS_USB
	default n

config CONFIG_CMDS_USB_HID
	bool "USB: HID class test demos"
	depends on BR2_PACKAGE_PREBUILTS_USBDRIVER_HID
	depends on CONFIG_CMDS_USB
	default n

config CONFIG_CMDS_USB_4G_RNDIS_NET_DEVICE
	bool "USB host: support sending AT command to 4G RNDIS network device"
	depends on BR2_PACKAGE_PREBUILTS_USBDRIVER_SERIAL
	depends on BR2_PACKAGE_PREBUILTS_USBDRIVER_RNDIS
	depends on CONFIG_CMDS_USB
	default n

config CONFIG_CMDS_USB_GADGET_MSC
	bool "USB gadget: mass-storage device commonds"
	depends on BR2_PACKAGE_PREBUILTS_USBGADGETDRIVER
	depends on BR2_PACKAGE_PREBUILTS_USBGADGETDRIVER_MSC
	depends on CONFIG_CMDS_USB
	default n

config CONFIG_CMDS_USB_GADGET_NCM
	bool "USB gadget: NCM device commonds"
	depends on BR2_PACKAGE_PREBUILTS_USBGADGETDRIVER
	depends on BR2_PACKAGE_PREBUILTS_USBGADGETDRIVER_NCM
	depends on CONFIG_CMDS_USB
	default n

config CONFIG_CMDS_USB_GADGET_SERIAL
	bool "USB gadget: Serial device commonds"
	depends on BR2_PACKAGE_PREBUILTS_USBGADGETDRIVER
	depends on BR2_PACKAGE_PREBUILTS_USBGADGETDRIVER_SERIAL
	depends on CONFIG_CMDS_USB
	default n

config CONFIG_CMDS_USB_GADGET_ZERO
	bool "USB gadget: Zero demo"
	depends on BR2_PACKAGE_PREBUILTS_USBGADGETDRIVER
	depends on CONFIG_USB_ZERO
	depends on CONFIG_CMDS_USB
	default n

config CONFIG_CMDS_USB_GADGET_HID
	bool "USB gadget: HID device demo (mouse/keyboard)"
	depends on BR2_PACKAGE_PREBUILTS_USBGADGETDRIVER
	depends on BR2_PACKAGE_PREBUILTS_USBGADGETDRIVER_HID
	depends on CONFIG_CMDS_USB
	default n

config CONFIG_CMDS_USB_GADGET_HID_TP
	bool "USB gadget: HID device demo (touch panel)"
	depends on BR2_PACKAGE_PREBUILTS_USBGADGETDRIVER
	depends on BR2_PACKAGE_PREBUILTS_USBGADGETDRIVER_HID_TP
	depends on CONFIG_CMDS_USB
	default n


config CONFIG_CMDS_USB_GADGET_UAC1
	bool "USB gadget: UAC1 device commonds"
	depends on BR2_PACKAGE_PREBUILTS_USBGADGETDRIVER
	depends on BR2_PACKAGE_PREBUILTS_USBGADGETDRIVER_UAC1
	depends on CONFIG_CMDS_USB
	default n

config CONFIG_CMDS_USB_GADGET_UVC
	bool "USB gadget: video device commonds (uvc class)"
	depends on BR2_PACKAGE_PREBUILTS_USBGADGETDRIVER
	depends on BR2_PACKAGE_PREBUILTS_USBGADGETDRIVER_UVC
	depends on CONFIG_CMDS_USB
	default n

config CONFIG_CMDS_USB_GADGET_WINUSB
	bool "USB gadget: winusb(wcid) commonds"
	depends on BR2_PACKAGE_PREBUILTS_USBGADGETDRIVER
	depends on BR2_PACKAGE_PREBUILTS_USBGADGETDRIVER_WINUSB
	depends on CONFIG_CMDS_USB
	default n

config CONFIG_CMDS_USB_GADGET_LOCK
	bool "USB gadget: lock demo(uvc + uac)"
	depends on BR2_PACKAGE_PREBUILTS_USBGADGETDRIVER
	depends on BR2_PACKAGE_PREBUILTS_USBGADGETDRIVER_UVC
	depends on BR2_PACKAGE_PREBUILTS_USBGADGETDRIVER_UAC1
	depends on CONFIG_CMDS_USB
	default n
```

## components/ffmpeg/Kconfig.plugins
```kconfig
menuconfig BR2_PACKAGE_FFMPEG_PLUGINS
	bool "ffmpeg plugins"
	default y

if BR2_PACKAGE_FFMPEG_PLUGINS
source "Kconfig.plugins.protocols"
source "Kconfig.plugins.demuxers"
source "Kconfig.plugins.parsers"
source "Kconfig.plugins.decoders"
endif
```
