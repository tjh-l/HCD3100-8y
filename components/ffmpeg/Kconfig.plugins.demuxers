## components/ffmpeg/Kconfig.plugins.demuxers
```kconfig
menuconfig BR2_PACKAGE_FFMPEG_PLUGINS_DEMUXERS
	bool "ffmpeg demuxer plugins"
	default y

if BR2_PACKAGE_FFMPEG_PLUGINS_DEMUXERS

config BR2_PACKAGE_FFMPEG_DEMUXER_RTSP
	bool "rtsp demuxer"
	default n

config BR2_PACKAGE_FFMPEG_DEMUXER_HLS
	bool "hls demuxer"
	default n

config BR2_PACKAGE_FFMPEG_DEMUXER_DTS
	bool "dts demuxer"
	default n

config BR2_PACKAGE_FFMPEG_DEMUXER_MOV
	bool "mov demuxer"
	default n

config BR2_PACKAGE_FFMPEG_DEMUXER_M4V
	bool "m4v demuxer"
	default n

config BR2_PACKAGE_FFMPEG_DEMUXER_ASF
	bool "asf demuxer"
	default n
	
config BR2_PACKAGE_FFMPEG_DEMUXER_AVI
	bool "avi demuxer"
	default n

config BR2_PACKAGE_FFMPEG_DEMUXER_FLV
	bool "flv demuxer"
	default n
	
config BR2_PACKAGE_FFMPEG_DEMUXER_MKV
	bool "matroska demuxer"
	default n
	
config BR2_PACKAGE_FFMPEG_DEMUXER_MPEGPS
	bool "mpegps demuxer"
	default n

config BR2_PACKAGE_FFMPEG_DEMUXER_MPEGTS
	bool "mpegts demuxer"
	default n
	
config BR2_PACKAGE_FFMPEG_DEMUXER_RM
	bool "rm demuxer"
	default n
	
config BR2_PACKAGE_FFMPEG_DEMUXER_OGG
	bool "ogg demuxer"
	default n
	
config BR2_PACKAGE_FFMPEG_DEMUXER_SWF
	bool "swf demuxer"
	default n

config BR2_PACKAGE_FFMPEG_DEMUXER_DV
	bool "dv demuxer"
	default n

config BR2_PACKAGE_FFMPEG_DEMUXER_NUV
	bool "nuv demuxer"
	default n

config BR2_PACKAGE_FFMPEG_DEMUXER_GXF
	bool "gxf demuxer"
	default n
	
config BR2_PACKAGE_FFMPEG_DEMUXER_MXF
	bool "mxf demuxer"
	default n
	
config BR2_PACKAGE_FFMPEG_DEMUXER_NUT
	bool "nut demuxer"
	default n

config BR2_PACKAGE_FFMPEG_DEMUXER_MP3
	bool "mp3 demuxer"
	default n

config BR2_PACKAGE_FFMPEG_DEMUXER_AA
	bool "aa demuxer"
	default n
	
config BR2_PACKAGE_FFMPEG_DEMUXER_ACT
	bool "act demuxer"
	default n

config BR2_PACKAGE_FFMPEG_DEMUXER_AIFF
	bool "aiff demuxer"
	default n

config BR2_PACKAGE_FFMPEG_DEMUXER_WAV
	bool "wav demuxer"
	default n

config BR2_PACKAGE_FFMPEG_DEMUXER_APE
	bool "ape demuxer"
	default n
	
config BR2_PACKAGE_FFMPEG_DEMUXER_AAC
	bool "aac demuxer"
	default n

config BR2_PACKAGE_FFMPEG_DEMUXER_FLAC
	bool "flac demuxer"
	default n
	
config BR2_PACKAGE_FFMPEG_DEMUXER_AC3
	bool "ac3 demuxer"
	default n

config BR2_PACKAGE_FFMPEG_DEMUXER_EAC3
	bool "eac3 demuxer"
	default n	
	
config BR2_PACKAGE_FFMPEG_DEMUXER_AMR
	bool "amr demuxer"
	default n
	
config BR2_PACKAGE_FFMPEG_DEMUXER_AU
	bool "au demuxer"
	default n	
	
config BR2_PACKAGE_FFMPEG_DEMUXER_CAF
	bool "caf demuxer"
	default n	

config BR2_PACKAGE_FFMPEG_DEMUXER_GSM
	bool "gsm demuxer"
	default n

config BR2_PACKAGE_FFMPEG_DEMUXER_AVR
	bool "avr demuxer"
	default n
	
config BR2_PACKAGE_FFMPEG_DEMUXER_IRCAM
	bool "ircam demuxer"
	default n
	
config BR2_PACKAGE_FFMPEG_DEMUXER_MLP
	bool "mlp demuxer"
	default n
	
config BR2_PACKAGE_FFMPEG_DEMUXER_MTV
	bool "mtv demuxer"
	default n
	
config BR2_PACKAGE_FFMPEG_DEMUXER_NISTSPHERE
	bool "nistsphere demuxer"
	default n
	
config BR2_PACKAGE_FFMPEG_DEMUXER_PVF
	bool "pvf demuxer"
	default n

config BR2_PACKAGE_FFMPEG_DEMUXER_MPC
	bool "mpc demuxer"
	default n

config BR2_PACKAGE_FFMPEG_DEMUXER_RSO
	bool "rso demuxer"
	default n

config BR2_PACKAGE_FFMPEG_DEMUXER_VOC
	bool "voc demuxer"
	default n

config BR2_PACKAGE_FFMPEG_DEMUXER_EPAF
	bool "epaf demuxer"
	default n

config BR2_PACKAGE_FFMPEG_DEMUXER_QCP
	bool "qcp demuxer"
	default n

config BR2_PACKAGE_FFMPEG_DEMUXER_TAK
	bool "tak demuxer"
	default n

config BR2_PACKAGE_FFMPEG_DEMUXER_W64
	bool "w64 demuxer"
	default n

config BR2_PACKAGE_FFMPEG_DEMUXER_WV
	bool "wv demuxer"
	default n

config BR2_PACKAGE_FFMPEG_DEMUXER_TTA
	bool "tta demuxer"
	default n

config BR2_PACKAGE_FFMPEG_DEMUXER_PCM
	bool "pcm demuxer"
	default n

config BR2_PACKAGE_FFMPEG_DEMUXER_DSF
	bool "dsf demuxer"
	default n

config BR2_PACKAGE_FFMPEG_DEMUXER_H264
	bool "h264 demuxer"
	default n
	
config BR2_PACKAGE_FFMPEG_DEMUXER_MPEGVIDEO
	bool "mpegvideo demuxer"
	default n

config BR2_PACKAGE_FFMPEG_DEMUXER_VC1
	bool "vc1 demuxer"
	default n

config BR2_PACKAGE_FFMPEG_DEMUXER_IMAGE2
	bool "image demuxer"
	default n

config BR2_PACKAGE_FFMPEG_DEMUXER_PNG
	bool "png demuxer"
	default n

config BR2_PACKAGE_FFMPEG_DEMUXER_JPG
	bool "jpg demuxer"
	default n
	
config BR2_PACKAGE_FFMPEG_DEMUXER_GIF
	bool "gif demuxer"
	default n
	
config BR2_PACKAGE_FFMPEG_DEMUXER_BMP
	bool "bmp demuxer"
	default n

config BR2_PACKAGE_FFMPEG_DEMUXER_TIFF
	bool "tiff demuxer"
	default n

config BR2_PACKAGE_FFMPEG_DEMUXER_WEBP
	bool "webp demuxer"
	default n

config BR2_PACKAGE_FFMPEG_DEMUXER_ASS
	bool "ass/ssa demuxer"
	default n

config BR2_PACKAGE_FFMPEG_DEMUXER_VOBSUB
	bool "vobsub demuxer"
	default n

config BR2_PACKAGE_FFMPEG_DEMUXER_MICRODVD
	bool "microdvd demuxer"
	default n

config BR2_PACKAGE_FFMPEG_DEMUXER_SAMI
	bool "smi/sami demuxer"
	default n

config BR2_PACKAGE_FFMPEG_DEMUXER_MPL2
	bool "mpl2 demuxer"
	default n

config BR2_PACKAGE_FFMPEG_DEMUXER_SRT
	bool "srt demuxer"
	default n

config BR2_PACKAGE_FFMPEG_DEMUXER_WEBVTT
	bool "webvtt demuxer"
	default n
	
config BR2_PACKAGE_FFMPEG_DEMUXER_LRC
	bool "lrc demuxer"
	default n

config BR2_PACKAGE_FFMPEG_DEMUXER_DVBSUB
	bool "dvbsub demuxer"
	default n

config BR2_PACKAGE_FFMPEG_DEMUXER_STL
	bool "stl demuxer"
	default n

config BR2_PACKAGE_FFMPEG_DEMUXER_SUBVIEWER1
	bool "subviewer1 demuxer"
	default n

config BR2_PACKAGE_FFMPEG_DEMUXER_PJS
	bool "pjs demuxer"
	default n

config BR2_PACKAGE_FFMPEG_DEMUXER_VPLAYER
	bool "vplayer demuxer"
	default n

config BR2_PACKAGE_FFMPEG_DEMUXER_TRUEHD
	bool "truehd demuxer"
	default n
	
config BR2_PACKAGE_FFMPEG_DEMUXER_ICO
	bool "ico demuxer"
	default n

endif
```

## components/ffmpeg/Kconfig.plugins.parsers
```kconfig
menuconfig BR2_PACKAGE_FFMPEG_PLUGINS_PARSERS
	bool "ffmpeg parser plugins"
	default y

if BR2_PACKAGE_FFMPEG_PLUGINS_PARSERS

config BR2_PACKAGE_FFMPEG_PARSER_MPEGAUDIO
	bool "mpegaudio parser"
	default n

config BR2_PACKAGE_FFMPEG_PARSER_AAC
	bool "aac parser"
	default n

config BR2_PACKAGE_FFMPEG_PARSER_AAC_LATM
	bool "aac_latm parser"
	default n
	
config BR2_PACKAGE_FFMPEG_PARSER_FLAC
	bool "flac parser"
	default n

config BR2_PACKAGE_FFMPEG_PARSER_XMA
	bool "xma parser"
	default n

config BR2_PACKAGE_FFMPEG_PARSER_OPUS
	bool "opus parser"
	default n

config BR2_PACKAGE_FFMPEG_PARSER_VORBIS
	bool "vorbis parser"
	default n

config BR2_PACKAGE_FFMPEG_PARSER_COOK
	bool "cook parser"
	default n

config BR2_PACKAGE_FFMPEG_PARSER_AC3
	bool "ac3 parser"
	default n

config BR2_PACKAGE_FFMPEG_PARSER_MLP
	bool "mlp parser"
	default n

config BR2_PACKAGE_FFMPEG_PARSER_GSM
	bool "gsm parser"
	default n

config BR2_PACKAGE_FFMPEG_PARSER_SIPR
	bool "sipr parser"
	default n

config BR2_PACKAGE_FFMPEG_PARSER_MJPEG
	bool "mjpeg parser"
	default n
	
config BR2_PACKAGE_FFMPEG_PARSER_PNG
	bool "png parser"
	default n

config BR2_PACKAGE_FFMPEG_PARSER_GIF
	bool "gif parser"
	default n

config BR2_PACKAGE_FFMPEG_PARSER_BMP
	bool "bmp parser"
	default n

config BR2_PACKAGE_FFMPEG_PARSER_WEBP
	bool "webp parser"
	default n

config BR2_PACKAGE_FFMPEG_PARSER_DVBSUB
	bool "dvbsub parser"
	default n

config BR2_PACKAGE_FFMPEG_PARSER_H264
	bool "h264 parser"
	default n

config BR2_PACKAGE_FFMPEG_PARSER_MPEGVIDEO
	bool "mpegvideo parser"
	default n

config BR2_PACKAGE_FFMPEG_PARSER_VC1
	bool "vc1 parser"
	default n

config BR2_PACKAGE_FFMPEG_PARSER_H263
	bool "H263 parser"
	default n

config BR2_PACKAGE_FFMPEG_PARSER_RV30
	bool "rv30 parser"
	default n

config BR2_PACKAGE_FFMPEG_PARSER_RV40
	bool "rv40 parser"
	default n

config BR2_PACKAGE_FFMPEG_PARSER_MPEG4VIDEO
	bool "mpeg4video parser"
	default n

endif
```

## components/ffmpeg/Kconfig.plugins.protocols
```kconfig
menuconfig BR2_PACKAGE_FFMPEG_PLUGINS_PROTOCOLS
	bool "ffmpeg protocol plugins"
	default y

if BR2_PACKAGE_FFMPEG_PLUGINS_PROTOCOLS

config BR2_PACKAGE_FFMPEG_PROTOCOL_FILE
	bool "file protocol"
	default n

config BR2_PACKAGE_FFMPEG_PROTOCOL_HTTP
	bool "http protocol"
	default n

config BR2_PACKAGE_FFMPEG_PROTOCOL_HTTPS
	bool "https protocol"
	default n

config BR2_PACKAGE_FFMPEG_PROTOCOL_HTTPPROXY
	bool "httpproxy protocol"
	default n

config BR2_PACKAGE_FFMPEG_PROTOCOL_FTP
	bool "ftp protocol"
	default n

config BR2_PACKAGE_FFMPEG_PROTOCOL_TCP
	bool "tcp protocol"
	default n

config BR2_PACKAGE_FFMPEG_PROTOCOL_UDP
	bool "udp protocol"
	default n

config BR2_PACKAGE_FFMPEG_PROTOCOL_RTP
	bool "rtp protocol"
	default n

config BR2_PACKAGE_FFMPEG_PROTOCOL_RTMP
	bool "rtmp protocol"
	default n

config BR2_PACKAGE_FFMPEG_PROTOCOL_RTMPT
	bool "rtmpt protocol"
	default n

endif
```

## components/hc-examples/Kconfig
```kconfig
menuconfig BR2_PACKAGE_HC_EXAMPLES
	bool "hc-examples"
	default n

if BR2_PACKAGE_HC_EXAMPLES
config BR2_PACKAGE_HDMI_WIREELSS_EXAMPLE
	bool "hdmi wireless example"
	default n
	select CONFIG_NET

if BR2_PACKAGE_HDMI_WIREELSS_EXAMPLE
choice
	bool "hdmi wireless sample sending data way"
	default BR2_PACKAGE_HDMI_WIRELSS_DISPLAY_RAW

config BR2_PACKAGE_HDMI_WIRELSS_DISPLAY_RAW
	bool "Calling netowork driver api directly"

config BR2_PACKAGE_HDMI_WIRELSS_DISPLAY_TCP
	bool "Using tcp"

config BR2_PACKAGE_HDMI_WIRELSS_DISPLAY_UDP
	bool "Using udp"

endchoice
endif

config BR2_PACKAGE_VIDEO_PBP_EXAMPLES
	bool "video picture by picture mode test examples"
	default n

config BR2_PACKAGE_SCREENSHOT_EXAMPLES
	bool "screenshot examples"
	default n

config BR2_PACKAGE_BLUETOOTH_EXAMPLES
	bool "bluetooth examples"
	default n

menuconfig BR2_PACKAGE_HDMIRX_EXAMPLES
	bool "HDMI rx examples"
	default n

if BR2_PACKAGE_HDMIRX_EXAMPLES
config CONFIG_CMDS_HDMI_RX_SORTING
	bool "enable hdmrx sorting test"
	default n
endif


config BR2_PACKAGE_TVDEC_EXAMPLES
	bool "TV dec(CVBS rx) examples"
	default n


menuconfig BR2_PACKAGE_HCCAST_EXAMPLES
	bool "hccast test examples"
	default n

if BR2_PACKAGE_HCCAST_EXAMPLES
config BR2_PACKAGE_HCCAST_WIFI_CAST_EXAMPLES
	bool "hccast wifi cast test examples"
	default n

config BR2_PACKAGE_HCCAST_USB_CAST_EXAMPLES
	bool "hccast usb test examples"
	default n

endif



menuconfig BR2_PACKAGE_HC_EXAMPLES_HUDI
	bool "hudi examples"
	default n

if BR2_PACKAGE_HC_EXAMPLES_HUDI
config BR2_PACKAGE_HC_EXAMPLES_HUDI_CEC
    bool "hudi cec example"
	select BR2_PACKAGE_HUDI_CEC 
    default n
    help
      hdmi cec interface example
endif

endif
```

## components/hccast/Kconfig
```kconfig
menuconfig BR2_PACKAGE_HCCAST
	bool "hccast"
	default n
	select BR2_PACKAGE_HUDI
	select BR2_PACKAGE_HUDI_VIDEO
	select BR2_PACKAGE_HUDI_AUDIO
	select BR2_PACKAGE_HUDI_DISPLAY
	select BR2_PACKAGE_HUDI_AVSYNC
	select BR2_PACKAGE_HUDI_DSC
	select BR2_PACKAGE_PREBUILTS_LIBEFUSE
	help
	  Hichip screen casting middleware and simple demo application

if BR2_PACKAGE_HCCAST

config BR2_PACKAGE_HCCAST_NET
	bool "Wi-Fi MGR & DHCP"
	default n
	help
	  Support Wi-Fi Manager and DHCP server/client API

config BR2_PACKAGE_HCCAST_WIRELESS
	bool "Wireless casting"
	default n
	select BR2_PACKAGE_HCCAST_NET
	help
	  Support Wireless casting API, DLNA/Miracast/Aircast
	  
if BR2_PACKAGE_HCCAST_WIRELESS

config BR2_PACKAGE_HCCAST_AIRCAST
	bool "Aircast"
	default y
	select CONFIG_SPI_SPIDEV
	select CONFIG_DRV_SPI
	select BR2_PACKAGE_WOLFSSL

if BR2_PACKAGE_HCCAST_AIRCAST

config BR2_PACKAGE_HCCAST_AIRCAST_MIRROR_ONLY
	bool "Air-mirror only"
	default n
	help
	  Support Aircast only support screen mirrorring mode

config BR2_PACKAGE_HCCAST_AIRP2P_SUPPORT
	bool "Airp2p"
	default n
	select CONFIG_NET_LWIP_IPV6
	select CONFIG_LWIP_TCP_SACK_OUT
	select CONFIG_LWIP_TCP_TIMESTAMPS
	select CONFIG_NET_SKB_HEAD_RESERVE
	help
	  Support Airp2p	  

endif

config BR2_PACKAGE_HCCAST_MIRACAST
	bool "Miracast"
	select BR2_PACKAGE_WOLFSSL
	default y

config BR2_PACKAGE_HCCAST_DLNA
	bool "DLNA"
	default y

if BR2_PACKAGE_HCCAST_DLNA

config BR2_PACKAGE_HCCAST_DIAL
    bool "DIAL"
    select BR2_PACKAGE_PREBUILTS_LIBYOUTUBE
    select BR2_PACKAGE_HCCAST_IPTV
    default n
    help
      support yt dial cast

endif

endif

config BR2_PACKAGE_HCCAST_USBMIRROR
	bool "USB mirrorring"
	default n
	select CONFIG_DRV_SPI
	select CONFIG_SPI_SPIDEV
	select BR2_PACKAGE_WOLFSSL
	help
	  Support IUM & AUM

if BR2_PACKAGE_HCCAST_USBMIRROR

config BR2_PACKAGE_HCCAST_USBMIRROR_SLAVE
	bool "Slave mode support"
	default n
	help
	  Support usb device mode

endif

config BR2_PACKAGE_HCCAST_IPTV
	bool "IPTV porting layer"
	default n
	help
	  Support IPTV API

endif
```

## components/hclib/Kconfig
```kconfig
menu "Hichip Libs"
source "viddriver/Kconfig"
source "auddriver/Kconfig"
source "libacodec/Kconfig"
source "libswxf/Kconfig"
source "libswisp/Kconfig"
source "libswtwill/Kconfig"
source "mipidriver/Kconfig"
source "hctinyplayer/Kconfig"
source "ffplayer/Kconfig"
source "lnxporting/Kconfig"
source "usbdriver/Kconfig"
source "mmcdriver/Kconfig"
source "libntfs/Kconfig"
source "libtoe/Kconfig"
source "libdsc/Kconfig"
source "libge/Kconfig"
source "ddrinit/Kconfig"
source "libws2811/Kconfig"
source "display/Kconfig"
source "libefuse/Kconfig"
source "rtl8188fu/Kconfig"
source "rtl8188eu/Kconfig"
source "rtl8811cu/Kconfig"
source "rtl8733bu/Kconfig"
source "rtl8822cs/Kconfig"
source "rtl8723as/Kconfig"
source "rtl8723bs/Kconfig"
source "ecr6600u/Kconfig"
source "rtl8733bs/Kconfig"
source "wpa_supplicant/Config.in"
source "wireless_tools/Config.in"
source "hotspot/Config.in"
source "libhidalgo/Kconfig"
endmenu
```

## components/hclib/ecr6600u/Kconfig
```kconfig
config BR2_PACKAGE_ECR6600U
	bool "ecr6600u wifi"
	depends on CONFIG_NET
	select CONFIG_DRV_LNXDRIVER
	select CONFIG_DRV_SOFTIRQ
	default n
```

## components/hclib/hotspot/Config.in
```kconfig
config BR2_PACKAGE_HOTSPOT
	bool "hotspot"
	select CONFIG_NET
	help
		Bridge wlan to ethernet
```

## components/hclib/rtl8723as/Kconfig
```kconfig
config BR2_PACKAGE_RTL8723AS
	bool "rtl8723as wifi"
	depends on CONFIG_NET
	select CONFIG_DRV_LNXDRIVER
	select CONFIG_DRV_SOFTIRQ
	default n
```

## components/hclib/rtl8723bs/Kconfig
```kconfig
config BR2_PACKAGE_RTL8723BS
	bool "rtl8723bs wifi"
	depends on CONFIG_NET
	select CONFIG_DRV_LNXDRIVER
	select CONFIG_DRV_SOFTIRQ
	default n
```

## components/hclib/rtl8733bs/Kconfig
```kconfig
config BR2_PACKAGE_RTL8733BS
	bool "rtl8733bs wifi"
	depends on CONFIG_NET
	select CONFIG_DRV_LNXDRIVER
	select CONFIG_DRV_SOFTIRQ
	default n
```

## components/hclib/rtl8822cs/Kconfig
```kconfig
config BR2_PACKAGE_RTL8822CS
	bool "rtl8822cs wifi"
	depends on CONFIG_NET
	select CONFIG_DRV_LNXDRIVER
	select CONFIG_DRV_SOFTIRQ
	default n
```

## components/hctinyplayer-registry/Kconfig
```kconfig
menuconfig BR2_PACKAGE_HCTINYPLAYER_REGISTRY
	bool "hctinyplayer registry"
	default n

comment "Error!!! DO NOT select both hctinyplayer and ffplayer!!!"
	depends on BR2_PACKAGE_HCTINYPLAYER_REGISTRY && BR2_PACKAGE_PREBUILTS_FFPLAYER

if BR2_PACKAGE_HCTINYPLAYER_REGISTRY
config BR2_PACKAGE_HCTINYPLAYER_TEST
	bool "hctinyplayer test cmds"
	default n

config BR2_PACKAGE_HCTINYPLAYER_PROTOCOL_FILE
	bool "hctinyplayer protocol file"
	default y

config BR2_PACKAGE_HCTINYPLAYER_DEMUXER_FLV
	bool "hctinyplayer demuxer flv"
	default y

config BR2_PACKAGE_HCTINYPLAYER_DEMUXER_MJPEG
	bool "hctinyplayer demuxer mjpeg"
	default y

config BR2_PACKAGE_HCTINYPLAYER_PARSER_MPEGAUDIO
	bool "hctinyplayer parser mpegaudio"
	default n

config BR2_PACKAGE_HCTINYPLAYER_PARSER_H264
	bool "hctinyplayer parser h264"
	default n
endif
```
