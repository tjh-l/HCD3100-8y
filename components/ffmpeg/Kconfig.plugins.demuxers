## components/hudi/Kconfig
```kconfig
menuconfig BR2_PACKAGE_HUDI
	bool "hudi"
	default n
	help
	  Hichip Uniform Driver Interface

if BR2_PACKAGE_HUDI

config BR2_PACKAGE_HUDI_FLASH
	bool "flash"
	default n
	help
	  Support flash operation interface

config BR2_PACKAGE_HUDI_VIDEO
	bool "video"
	default n
	help
	  Support video driver interface

config BR2_PACKAGE_HUDI_AUDIO
	bool "audio"
	default n
	help
	  Support audio driver interface

config BR2_PACKAGE_HUDI_DISPLAY
	bool "display"
	default n
	help
	  Support display engine interface

config BR2_PACKAGE_HUDI_AVSYNC
	bool "avsync"
	default n
	help
	  Support A/V sync interface

config BR2_PACKAGE_HUDI_CEC
	bool "cec"
	default n
	help
	  Support hdmi cec interface

config BR2_PACKAGE_HUDI_DSC
	bool "dsc"
	default n
	help
	  Support dsc interface

config BR2_PACKAGE_HUDI_PERSISTENTMEM
	bool "persistentmem"
	default n
	help
	  Support persistentmem Interface

config BR2_PACKAGE_HUDI_POWER
	bool "power"
	default n
	help
	  Support power interface

config BR2_PACKAGE_HUDI_BLUETOOTH
	bool "bluetooth"
	default n
	help
	  Support bluetooth interface

config BR2_PACKAGE_HUDI_HDMI
	bool "hdmi"
	default n
	help
	  Support hdmi interface

config BR2_PACKAGE_HUDI_CVBS_RX
	bool "cvbsrx"
	default n
	help
	  Support cvbs_rx interface

config BR2_PACKAGE_HUDI_SCREEN
	bool "screen"
	default n
	help
	  Support screen interface

config BR2_PACKAGE_HUDI_HDMIRX
	bool "hdmirx"
	default n
	help
	  Support hdmi rx interface


endif
```

## components/kernel/source/drivers/Kconfig
```kconfig
menu "Drivers"

menuconfig CONFIG_DRV_UART
        bool "Uart driver"
        default y

if CONFIG_DRV_UART
source "uart/Kconfig"
endif

menuconfig CONFIG_DRV_VIRTUART
        bool "Virtual uart driver"
        default y

if CONFIG_DRV_VIRTUART
source "virtuart/Kconfig"
endif

menuconfig CONFIG_DRV_FILEUART
        bool "File uart driver"
        default n

if CONFIG_DRV_FILEUART
source "fileuart/Kconfig"
endif

config CONFIG_DRV_DUMMYUART
        bool "Dummy uart driver"
        default y

config CONFIG_DRV_DEVNULL
        bool "Enable /dev/null"
        default y

config CONFIG_DRV_DEVZERO
        bool "Enable /dev/zero"
        default n

config CONFIG_DRV_SOFTIRQ
        bool "Softirq support"
        default n

menuconfig CONFIG_DRV_LNXDRIVER
        bool "Lnx support"
        default n

if CONFIG_DRV_LNXDRIVER
config CONFIG_SCHED_LNXWORKSTACKSIZE
	hex "Default lnx work stack size in uint32_t"
	default 0x1000

config CONFIG_SCHED_SOFTIRQD_HI_PRIORITY
	int "Default lnx softirqd hi task priority"
	default CONFIG_TASK_CRITICAL_PRIORITY

menuconfig CONFIG_SCHED_SOFTIRQD_HI_RESCHED
	bool "Enable softirqd hi task resched"
	default y

if CONFIG_SCHED_SOFTIRQD_HI_RESCHED
config CONFIG_SCHED_SOFTIRQD_HI_RESCHED_PRIORITY
	int "Default lnx softirqd hi task resched priority"
	default CONFIG_TASK_CRITICAL_PRIORITY
endif

config CONFIG_SCHED_SOFTIRQD_PRIORITY
	int "Default lnx softirqd task priority"
	default CONFIG_TASK_CRITICAL_PRIORITY

menuconfig CONFIG_SCHED_SOFTIRQD_RESCHED
	bool "Enable softirqd task resched"
	default y

if CONFIG_SCHED_SOFTIRQD_RESCHED
config CONFIG_SCHED_SOFTIRQD_RESCHED_PRIORITY
	int "Default lnx softirqd task resched priority"
	default CONFIG_TASK_CRITICAL_PRIORITY
endif

endif

menuconfig CONFIG_DRV_WQUEUE
        bool "Workqueue support"
        default y

if CONFIG_DRV_WQUEUE
source "wqueue/Kconfig"
endif

menuconfig CONFIG_DRV_AMPRPC
        bool "AMP RPC support"
	select CONFIG_SCHED_RPCWORK
	select CONFIG_SCHED_HPWORK
	select CONFIG_WQUEUE_NOTIFIER
	depends on CONFIG_SOC_HC16XX
        default n

if CONFIG_DRV_AMPRPC
source "amprpc/Kconfig"
endif

config CONFIG_DRVR_RAMDISK
	bool "Ramdisk"
	default n

config CONFIG_DRVR_MKRD
	bool "RAM disk wrapper (mkrd)"
	default n
	---help---
		Build the mkrd() function which serves as a wrapper to simplify
		creation of RAM disks.  If the boardctrl() interface is enabled,
		the selecting this option will also enable the BOARDIOC_MKRD
		command that will support creation of RAM disks from applications.

source "bch/Kconfig"

source "mtd/Kconfig"

source "pipes/Kconfig"

menu "Buffering"

config CONFIG_DRVR_WRITEBUFFER
	bool "Enable write buffer support"
	default n
	---help---
		Enable generic write buffering support that can be used by a variety
		of drivers.

if CONFIG_DRVR_WRITEBUFFER

config CONFIG_DRVR_WRDELAY
	int "Write flush delay"
	default 350
	---help---
		If there is no write activity for this configured amount of time,
		then the contents will be automatically flushed to the media.  This
		reduces the likelihood that data will be stuck in the write buffer
		at the time of power down.

endif # CONFIG_DRVR_WRITEBUFFER

config CONFIG_DRVR_READAHEAD
	bool "Enable read-ahead buffer support"
	default n
	---help---
		Enable generic read-ahead buffering support that can be used by a
		variety of drivers.

if CONFIG_DRVR_WRITEBUFFER || CONFIG_DRVR_READAHEAD

config CONFIG_DRVR_READBYTES
	bool "Support byte read method"
	default y if CONFIG_MTD_BYTE_WRITE
	default n if !CONFIG_MTD_BYTE_WRITE

config CONFIG_DRVR_REMOVABLE
	bool "Support removable media"
	default n

config CONFIG_DRVR_INVALIDATE
	bool "Support cache invalidation"
	default n

endif # CONFIG_DRVR_WRITEBUFFER || CONFIG_DRVR_READAHEAD

endmenu # Buffering

config CONFIG_DEV_MMZ
	bool "mmz dev"
	default y

menuconfig CONFIG_DRV_VIDEO
	bool "video"
	default n

if CONFIG_DRV_VIDEO
source "video/Kconfig"
endif


config CONFIG_DRV_PINMUX
	bool "pinmux"
	default y

config CONFIG_DRV_GPIO
	bool "gpio"
	default y

source "av/Kconfig"

config CONFIG_DRV_POK
	bool "pok Support"
	default n

menuconfig CONFIG_DRV_INPUT
	bool "input event"
	default y

if CONFIG_DRV_INPUT
source "input/Kconfig"
endif

menuconfig CONFIG_DRV_SPI
	bool "spi support"
	default y

if CONFIG_DRV_SPI
source "spi/Kconfig"
endif

config CONFIG_DRV_LVDS
	bool "lvds"
	depends on CONFIG_SOC_HC16XX
	default n

config CONFIG_DRV_RGB
	bool "rgb"
	depends on CONFIG_SOC_HC15XX
	default n

config CONFIG_DRV_MIPI
	bool "mipi"
	depends on CONFIG_SOC_HC16XX
	default y

source "i2c/Kconfig"

source "pwm/Kconfig"

config CONFIG_DRV_NBDBG
	bool "NB debug"
	default n

menuconfig CONFIG_DRV_APLATFORM
	bool "audio platform support"
	default y

if CONFIG_DRV_APLATFORM
source "aplatform/Kconfig"
endif

menuconfig CONFIG_DRV_WDT
	bool "watchdog"
	default y

if CONFIG_DRV_WDT
	source "watchdog/Kconfig"
endif

config CONFIG_DRV_PERSISTENTMEM
	bool "persistent memory"
	select CONFIG_LIB_CRC
	select CONFIG_MTD_BYTE_WRITE
	default y

config CONFIG_DRV_PERSISTENTMEM_FS
	bool "persistent memory based on filesystem"
	select CONFIG_LIB_CRC
	default n

config CONFIG_DRV_HWSPINLOCK
        bool "hwspinlock"
        default n

menuconfig CONFIG_DRV_KSHM
	bool "kshm driver"
	select CONFIG_DRV_HWSPINLOCK
	default y

if CONFIG_DRV_KSHM
	source "kshm/Kconfig"
endif

config CONFIG_DRV_HCGE
	bool "hcge driver"
	default n

menuconfig CONFIG_DRV_STANDBY
        bool "standby driver"
        default n

if CONFIG_DRV_STANDBY
source "standby/Kconfig"
endif

menuconfig CONFIG_DRV_DVP
	bool "dvp driver"
	default n

if CONFIG_DRV_DVP
source "dvp/Kconfig"
endif

source "crypto/Kconfig"

menuconfig CONFIG_USB_VENDOR
	bool "USB vendor setting"
	default n
	---help---
		USB vendor setting for HICHIP SOC

if CONFIG_USB_VENDOR
	source "usb/Kconfig"
endif
 
menuconfig CONFIG_DRV_LCD
	bool "lcd driver"
	default n

if CONFIG_DRV_LCD
source "lcd/Kconfig"
endif

menuconfig CONFIG_DRV_RTC
	bool "rtc driver"
	default n

if CONFIG_DRV_RTC
source "rtc/Kconfig"
endif

menuconfig CONFIG_DRV_HDMI_SWITCH
	bool "HDMI switch"
	default n

if CONFIG_DRV_HDMI_SWITCH
source "hdmiswitch/Kconfig"
endif

config CONFIG_DRV_GLOCK
        bool "Enable global-lock"
        default n

endmenu
```

## components/kernel/source/drivers/dvp/Kconfig
```kconfig
config CONFIG_DVP_RN6752V1
	bool "RN6752V1"
	default n
	
config CONFIG_DVP_RN6752
	bool "RN6752"
	default n	

config CONFIG_DVP_BF3A03
	bool "bf3a03"
	default n

config CONFIG_DVP_GC0328
	bool "gc0328"
	default n
	
config CONFIG_DVP_MS7200
	bool "ms7200"
	default n

config CONFIG_DVP_TP2804
	bool "tp2804"
	default n
	
config CONFIG_DVP_GC0308
	bool "gc0308"
	default n
```

## components/kernel/source/drivers/hdmiswitch/Kconfig
```kconfig
if CONFIG_DRV_HDMI_SWITCH

choice
	prompt "HDMI switch select"
	
	config CONFIG_DRV_HDMI_SWITCH_MS9601
		bool "hdmi switch ms9601a driver"

endchoice
endif
```

## components/kernel/source/drivers/input/Kconfig
```kconfig
menuconfig CONFIG_RC_CORE
	bool "rc core"
	default y

if CONFIG_RC_CORE

source "rc/keymaps/Kconfig"

menuconfig CONFIG_RC_DECODERS
	bool "Remote controller decoders"
	default y

if CONFIG_RC_DECODERS

config CONFIG_IR_NEC_DECODER
	bool "nec decoder"
	default y

endif

menuconfig CONFIG_RC_DEVICES
	bool "Remote Controller devices"
	depends on CONFIG_RC_CORE
	default y

if CONFIG_RC_DEVICES

config CONFIG_RC_HC
	bool "HC remote controls"
	depends on CONFIG_RC_CORE
	default y

endif

endif

menuconfig CONFIG_TP
	bool "tp menu"
	default n

if CONFIG_TP
	source "tp/Kconfig"
endif

menuconfig CONFIG_MISC
	bool "misc"
	default n

if CONFIG_MISC
	source "misc/Kconfig"
endif

menuconfig CONFIG_SAR_ADC
	bool "saradc menu"
	default n

if CONFIG_SAR_ADC
	source "../saradc/Kconfig"
endif

config CONFIG_DRV_GPIO_KEY_GROUP
        bool "gpio key"
        depends on CONFIG_DRV_GPIO
        default n

config  CONFIG_DRV_GPIO_KEY
	bool "hc key gpio driver"
        depends on CONFIG_DRV_GPIO
	default n

menuconfig CONFIG_ROTARY_KEY
	bool "rotary key"
	default n

if CONFIG_ROTARY_KEY
	source "rotary_key/Kconfig"
endif

config CONFIG_INPUT_JOYDEV
	tristate "Joystick interface"
	help
	  Say Y here if you want your joystick or gamepad to be
	  accessible as char device 13:0+ - /dev/input/jsX device.

	  If unsure, say Y.

	  More information is available: <file:Documentation/input/joystick.txt>

	  To compile this driver as a module, choose M here: the
	  module will be called joydev.

source "joystick/Kconfig"
```

## components/kernel/source/drivers/input/joystick/Kconfig
```kconfig
#
# Joystick driver configuration
#
menuconfig CONFIG_INPUT_JOYSTICK
	bool "Joysticks/Gamepads"
	help
	  If you have a joystick, 6dof controller, gamepad, steering wheel,
	  weapon control system or something like that you can say Y here
	  and the list of supported devices will be displayed. This option
	  doesn't affect the kernel.

	  Please read the file <file:Documentation/input/joystick.txt> which
	  contains more information.

if CONFIG_INPUT_JOYSTICK

config CONFIG_JOYSTICK_XPAD
	tristate "X-Box gamepad support"
	depends on BR2_PACKAGE_PREBUILTS_USBDRIVER_HID
	depends on CONFIG_INPUT_JOYDEV
	help
	  Say Y here if you want to use the X-Box pad with your computer.
	  Make sure to say Y to "Joystick support" (CONFIG_INPUT_JOYDEV)
	  and/or "Event interface support" (CONFIG_INPUT_EVDEV) as well.

	  For information about how to connect the X-Box pad to USB, see
	  <file:Documentation/input/xpad.txt>.

	  To compile this driver as a module, choose M here: the
	  module will be called xpad.

endif
```

## components/kernel/source/drivers/input/misc/Kconfig
```kconfig
menuconfig CONFIG_SENSOR
	bool "sensor"
	default n

if CONFIG_SENSOR
	source "sensor/Kconfig"
endif

menuconfig CONFIG_TOUCHKEY
	bool "touchkey"
	default n

if CONFIG_TOUCHKEY
	source "tk/Kconfig"
endif
```
