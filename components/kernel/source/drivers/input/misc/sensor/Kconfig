## components/kernel/source/drivers/input/misc/sensor/Kconfig
```kconfig
menuconfig CONFIG_SENSOR_GSENSOR
	bool "gsensor"
	default n

if CONFIG_SENSOR_GSENSOR
	source "gsensor/Kconfig"
endif

menuconfig CONFIG_SENSOR_DSENSOR
	bool "distance sensor"
	default n

if CONFIG_SENSOR_DSENSOR
	source "dsensor/Kconfig"
endif
```

## components/kernel/source/drivers/input/misc/sensor/gsensor/Kconfig
```kconfig
config CONFIG_GSENSOR_SC7A20
	bool "sc7a20h gsensor"
	default n

config CONFIG_GSENSOR_QMA6100P
	bool "qma6100p gsensor"
	default n

config CONFIG_GSENSOR_STK8BAXX
	bool "stk8baxx gsensor "
	default n
```

## components/kernel/source/drivers/input/rotary_key/Kconfig
```kconfig
config CONFIG_HC_SAL61955M
	bool "sal61955m"
	default n

config CONFIG_HC_ES1106S
	bool "es1106s"
	default n
```

## components/kernel/source/drivers/input/tp/Kconfig
```kconfig
config CONFIG_HC_XPT2046
	bool "xpt2046"
	default n

config CONFIG_HC_HY46XX
	bool "hy46xx"
	default n

config CONFIG_HC_ILITEK
	bool "ilitek"
	default n

config CONFIG_HC_GT911
	bool "gt911"
	default n

config CONFIG_HC_BLT1680
	bool "blt1680"
	default n

config CONFIG_HC_SIS9509
	bool "sis9509"
	default n

config CONFIG_HC_FT5426
	bool "ft5426"
	default n

config CONFIG_HC_HYNITRON_CST8XXX
	bool "hynitron cst8xxx"
	default n
```

## components/kernel/source/drivers/kshm/Kconfig
```kconfig
choice  
	prompt "kshm data storage mode"
	default CONFIG_KSHM_STATIC_RING_BUFFER_MODE

	config CONFIG_KSHM_STATIC_RING_BUFFER_MODE
	bool "static ring buffer mode"
	---help---
		kshm write/read data to/from a static ring buffer

	config CONFIG_KSHM_DYNAMIC_BUFFER_LIST_MODE
	bool "dynamic buffer list mode"
	depends on !CONFIG_DRV_KSHM_FOR_DUALCORE
	---help---
		kshm write/read data to/from a dynamic buffer list
endchoice

config CONFIG_DRV_KSHM_FOR_DUALCORE
	bool "kshm for dualcore"
	default n
```

## components/kernel/source/drivers/lcd/Kconfig
```kconfig
config CONFIG_DRV_LCD_DEV
	bool "lcd dev"
	default n

config CONFIG_DRV_LCD_SC5014A
	bool "lcd sc5014 support"
	default n

config CONFIG_DRV_BACKLIGHT
	bool "backlight support"
	default n
```

## components/kernel/source/drivers/pwm/Kconfig
```kconfig
menuconfig CONFIG_PWM_DRIVER
	bool "PWM Driver Support"
	default n

if CONFIG_PWM_DRIVER
choice
	prompt "Select pwm frequency range"
	help
		About How to calculated PWM frequency
		freq = 27M / (div * (h_val + l_val));
		h_val = duty_ns / div /37;
		l_val = (period_ns - duty_ns) / div /37;
		To meet the adjustable level of 1%,
		the h_val and l_val have following requirements:
			Max(h_val + l_val) = 65535;
			Min(h_val + l_val) = 100;
		the div can set in make menuconfig:
			CONFIG_RANGE_411Hz_270KHz: div = 1;
			CONFIG_RANGE_206Hz_135KHz: div = 2;
			CONFIG_RANGE_103Hz_67KHz : div = 4;
			CONFIG_RANGE_50Hz_33KHz  : div = 8;
			CONFIG_RANGE_AUTO_SET    : when use only one channel ,
						   div will auto calculated to meet with the frequency you set;
		if div = 1; the rang is 411(Hz)-270(KHz),
		you can set bigger than 270(KHz), but adjustable level may not be 1%;

	default CONFIG_RANGE_AUTO_SET

	config CONFIG_RANGE_411Hz_270KHz
		bool "pwm frequency range 411(Hz) to 270(KHz)"

	config CONFIG_RANGE_206Hz_135KHz
		bool "pwm frequency range 206(Hz) to 135(KHz)"

	config CONFIG_RANGE_103Hz_67KHz
		bool "pwm frequency range 103(Hz) to 63(KHz)"

	config CONFIG_RANGE_50Hz_33KHz
		bool "pwm frequency range 50(Hz) to 33(KHz)"

	config CONFIG_RANGE_AUTO_SET
		bool "pwm frequency auto set when use only one channel"
endchoice
endif
```

## components/kernel/source/drivers/saradc/Kconfig
```kconfig
config CONFIG_KEY_ADC
	bool "key adc driver"
	select BR2_PACKAGE_PREBUILTS_LIBEFUSE
	default n

config CONFIG_POLL_ADC
	bool "poll adc driver"
	select BR2_PACKAGE_PREBUILTS_LIBEFUSE
	default n

config CONFIG_TOUCH_ADC
	bool "touch adc driver 16xx"
	default n

config CONFIG_KEY_ADC_SAVE_CALIBRATION_TO_OTP
	select BR2_PACKAGE_HUDI
	select BR2_PACKAGE_HUDI_FLASH
	select BR2_PACKAGE_PTHREAD
	bool "save adc calibration to flash otp area"
	default n

if CONFIG_KEY_ADC_SAVE_CALIBRATION_TO_OTP

choice
	prompt "select adc calibration save storage type"
	default CONFIG_KEY_ADC_SAVE_STORAGE_NOR_OTP

	config CONFIG_KEY_ADC_SAVE_STORAGE_NOR_OTP
		bool "nor flash otp"

	config CONFIG_KEY_ADC_SAVE_STORAGE_NAND_OTP
		bool "nand flash otp"
endchoice

endif
```

## components/kernel/source/drivers/standby/Kconfig
```kconfig
menuconfig CONFIG_STANDBY_DDR_SCAN
	bool "DDR scan test"
	default n
if CONFIG_STANDBY_DDR_SCAN
config CONFIG_STANDBY_REPORT_TO_UART
	bool "Report result to UART"
	default n
if CONFIG_STANDBY_REPORT_TO_UART
config CONFIG_STANDBY_UART_ID
	int "Select Uart ID"
	range 0 3
	default 0
endif

config CONFIG_STANDBY_REPORT_TO_REGISTER
	bool "Report result to Register"
	default n

config CONFIG_STANDBY_REPORT_TO_SCREEN
	bool "Report result to Screen"
	default n

config CONFIG_STANDBY_RESTART_AFTER_TEST
	bool "Restart after the test is complete"
	default n
endif

menuconfig CONFIG_STANDBY_WAKEUP_BY_I2C_DEVICE
bool "Supports i2c device wake-up"
default n

if CONFIG_STANDBY_WAKEUP_BY_I2C_DEVICE
config CONFIG_STANDBY_WAKEUP_BY_I2C_DEVICE1
	bool "I2C Device Type 1"
	default n
endif

choice
        prompt "Mode"
        default CONFIG_CLOSE_IP

        config CONFIG_OUT_HC_SCANCODE
        bool "Output Dubug Info"

        config CONFIG_CLOSE_IP
        bool "Enable Close IP"
endchoice

if CONFIG_CLOSE_IP && CONFIG_SOC_HC16XX

config CONFIG_CLOSE_SIDO
        bool "close sdio"
        default y

config CONFIG_CLOSE_VDAC
        bool "close vdac"
        default y

config CONFIG_CLOSE_LVDS_0
        bool "close lvds ch0"
        default y

config CONFIG_CLOSE_LVDS_1
        bool "close lvds ch1"
        default y

config CONFIG_CLOSE_MIPI
        bool "close mipi"
        default y

config CONFIG_CLOSE_CVBS
        bool "close cvbs"
        default y

config CONFIG_CLOSE_HDRX
        bool "close hdrx"
        default y

config CONFIG_CLOSE_DDR
        bool "close ddr"
        default n
endif
```

## components/kernel/source/drivers/usb/Kconfig
```kconfig
config CONFIG_USB_PHY_SETTING
    bool "enable USB PHY setting"
    default n

config CONFIG_USB_GADGET_VBUS_DETECT
    bool "detect usb#0 gadget connect/disconnect by VBUS"
    default n
    ---help---
        The hardware development board needs to be connected to
        the VBUS pin, then you can determine whether there is a
        USB host connection by detecting the VBUS status value.

menuconfig CONFIG_USB_GADGET_VENDOR
    bool "USB gadget vendor support"
    default n

    if CONFIG_USB_GADGET_VENDOR
        config CONFIG_USB_ZERO
            bool "usb gadget demo: zero"
            default n

        config CONFIG_USB_GADGET_WINUSB_VENDOR
            bool "usb gadget demo: winusb(WCID) vendor parameters"
            default n


    endif
```

## components/kernel/source/net/Kconfig
```kconfig
menu "Net"
menuconfig CONFIG_NET
	bool "Enable network"
	default n

if CONFIG_NET
config CONFIG_NET_LWIP_SACK
	bool "Enable Lwipsack"
	default y

	help
	  Answer Y to enable LiteOS support lwip.

choice
	depends on CONFIG_NET_LWIP_SACK
	prompt "Lwipsack"
	default CONFIG_NET_LWIP_SACK_2_1_2
	help
	  Enable Lwipsack for 2.x

config CONFIG_NET_LWIP_SACK_2_1_2
	bool "Enable Lwipsack (2.1.2)"
	depends on CONFIG_NET_LWIP_SACK

config CONFIG_NET_LWIP_SACK_2_1_3
	bool "Enable Lwipsack (2.1.3)"
	depends on CONFIG_NET_LWIP_SACK

endchoice

config CONFIG_NET_LWIP_PPP
	bool "ppp support"
	default n

config CONFIG_NET_LWIP_IPV6
	bool "IPv6 support"
	default n

config CONFIG_NET_LWIP_BRIDGE
	bool "Bridge support"
	default n

config CONFIG_NET_LWIP_SLIP
	bool "SLIP protocol support"
	default n

config CONFIG_NET_LWIP_6LOWPAN
	bool "6LoWPAN support"
	default n

config CONFIG_NET_LWIP_DIS_UDP_CHECKSUM_CHECK
	bool "Disable udp checksum check"
	default n

config CONFIG_NET_LWIP_DIS_TCP_CHECKSUM_CHECK
	bool "Disable tcp checksum check"
	default n

config CONFIG_NET_LWIP_DIS_IP_CHECKSUM_GEN
	bool "Disable ip checksum check"
	default n

config CONFIG_LWIP_TCP_SACK_OUT
	bool "Enable tcp sack out"
	default n

config CONFIG_LWIP_TCP_TIMESTAMPS
	bool "enable tcp timestamps"
	default n

config CONFIG_NETDEV_BUDGET
	int "Net device budget"
	default 300
	help
		Net device buget is for net device receive softirq,
		which every time irq receive max packats nums

config CONFIG_NET_SKB_HEAD_RESERVE
	bool "enable skb buffer reserve 64 byte int buffer head"
	default n

config CONFIG_NET_HOTSPOT
	bool "hotspot"
	select CONFIG_NET_LWIP_IPV6
	select BR2_PACKAGE_PREBUILTS_LIBHOTSPOT
	default n
	
menuconfig CONFIG_WIFI_DEBUG
	bool "Enable wifi debug"
	default n
	if CONFIG_WIFI_DEBUG
		config CONFIG_WIFI_DEV_DEINIT_DEBUG
			bool "Enable wifi dev deinit debug"
			default n
		
		config CONFIG_WIFI_ADAPTER_CHK_STATUS
			bool "Enable wifi adapter chk status"
			default n
			
		config CONFIG_WIFI_ADAPTER_RECV_DEBUG
			bool "Enable wifi adapter recv debug"
			default n
			
		config CONFIG_WIFI_RX_MIRROR_PRIO
			int "wifi rx miracast/dlna prio"
			default 15
			
		config CONFIG_WIFI_RX_AIR_PRIO
			int "wifi rx air prio"
			default 14

		config CONFIG_WIFI_MEMLIST_NUM_RX
			int "wifi memlist num rx"
			default 1536

		config CONFIG_WIFI_MEMLIST_NUM_TX
			int "wifi memlist num tx"
			default 512
	endif
endif
endmenu
```

## components/liblvgl/source/Kconfig
```kconfig
source "lvgl/Kconfig"

config  LV_USE_GPU_HICHIP
    bool "Enable hichip gpu"
    default y

config LV_HC_SCREEN_HOR_RES
	int "lvgl horizon resolution"
	default 1280

config LV_HC_SCREEN_VER_RES
	int "lvgl vertical resolution"
	default 720

config LV_HC_DRAW_BUF_SIZE
	int "lvgl draw buffer size"
	default 0
	help
	lvgl draw buffer size, in pixel, sugest at least 10 * LV_HC_SCREEN_HOR_RES
	default zero, then it is equal to LV_HC_SCREEN_HOR_RES * LV_HC_SCREEN_VER_RES)

config LV_HC_DRAW_BUF_COUNT
	int "draw buffer count"
	default 1
	range 1 2

config LV_USE_DUAL_FRAMEBUFFER
	bool "Enable dual framebuffer"
	default y

source "hc_examples/Kconfig"

choice LV_HC_FB_COLOR_DEPTH
    prompt "Framebuffer color depth."
    default LV_HC_FB_COLOR_DEPTH_16_ARGB4444
    help
	Framebuffer color depth to be used.

    config LV_HC_FB_COLOR_DEPTH_32
	bool "32: ARGB8888"
    config LV_HC_FB_COLOR_DEPTH_16_ARGB1555
	bool "16: ARGB1555"
    config LV_HC_FB_COLOR_DEPTH_16_ARGB4444
	bool "16: ARGB4444"
endchoice

config LV_HC_FB_COLOR_DEPTH
    int
    default 16 if LV_HC_FB_COLOR_DEPTH_16_ARGB4444 || LV_HC_FB_COLOR_DEPTH_16_ARGB1555
    default 32 if LV_HC_FB_COLOR_DEPTH_32

config LV_HC_DITHER
    bool "Enable dither"
    default n
    help
        Only for 16bit color depth of framebuffer, A background that is not
	a gradient will have a frosted feel.

menu "Hichip create font"
	config SIYUANHEITI_LIGHT_18_1B
                bool "Enable Chinse SiYuanHeiTi-Lightx 18, Bpp 1b"
		default n
	config SIYUANHEITI_LIGHT_22_1B
                bool "Enable Chinse SiYuanHeiTi-Lightx 22, Bpp 1b"
		default n
	config SIYUANHEITI_LIGHT_28_1B
                bool "Enable Chinse SiYuanHeiTi-Lightx 28, Bpp 1b"
		default n
	config SIYUANHEITI_LIGHT_28_2B
                bool "Enable Chinse SiYuanHeiTi-Lightx 28, Bpp 2b"
		default n
	config SIYUANHEITI_LIGHT_28_4B
                bool "Enable Chinse SiYuanHeiTi-Lightx 28, Bpp 4b"
		default n
	config SIYUANHEITI_LIGHT_3000_28_1B
                bool "Enable Chinse SiYuanHeiTi-Lightx_3000 28, Bpp 1b"
		default n
endmenu

config LV_HC_IR
	bool "Enable IR"
	default n
if LV_HC_IR
config LV_HC_IR_INPUT_DEV
	string "IR input device path"
	default "/dev/input/event0"
endif


config LV_HC_KEYSTONE_AA_SW_FIX
	bool "Enable keystone AA by using fb"
	default n

config LV_HC_KEYSTONE_AA_SW_FIX_ALWAYS_CHOP_BAD_EDGE
       bool "Enable keystone AA always chop bad edges"
       default n

config LV_HC_KEYSTONE_AA_SW_FIX_GC
       bool "Enable keystone AA gamma correction"
       default n

config LV_HC_KEYSTONE_AA_SW_FIX_KAF_CMD
       bool "Enable keystone AA kaf debug command"
       default n

config LV_HC_MODIFY_EDGE_FOR_DEBUG
       bool "Enable modifying edge for debug purpose"
       default n

config LV_HC_KEYSTONE_EQUAL_SCALE
	bool "Enable keystone equal scale by using fb"
	default n

config LV_ATTRIBUTE_MEM_ALIGN
	int "memory align"
	default 32
	help
		Will be added where memories needs to be aligned
		__attribute__((aligned(4)))

config LV_USE_HC_TP_MONKEY
    bool "Enable TP Monkey test"
    select LV_USE_MONKEY
    default n

config LV_HC_FBDEV_PATH
    string "Configure framebuffer device"
    default "/dev/fb0"

config LV_HC_MEM_FROM_MALLOC
    bool "Enable liblvgl memory from malloc in system, otherwize from framebuffer memory"
    default n
```

## components/liblvgl/source/hc_examples/Kconfig
```kconfig
config LV_HC_DEMO_APP
	bool "Enable demo app"
	default n

if LV_HC_DEMO_APP
menu "Hichip UI demo"
	choice
            prompt "Set the default BIDI direction"
            default LV_HC_UISLIDE_1280x720

            config LV_HC_UISLIDE_1024x600
                bool "UISlide of 1024x720 resolution"
            config LV_HC_UISLIDE_1280x720
                bool "UISlide of 1280x720 resolution"
            config LV_HC_METER_1280x720
                bool "Meter test of 1280x720 resolution"
        endchoice
endmenu

config LV_HC_DEMO_AUTO_START
	bool "Enable demo app auto start"
	default n
endif
```

## components/libssp/Kconfig
```kconfig
config BR2_PACKAGE_LIBSSP
	bool "Stack Smashing Protector(ssp)"
	default n
	help
	  When enabled "-fstack-protector -fstack-protector-all"
	  in cflags, some packages need a definition to
	  __stack_chk_guard and __stack_chk_fail() to pass the
	  API available when doing configure.
	  But the firmware will finally link the real definition of
	  __stack_chk_guard and __stack_chk_fail() in libc.
	  The build framework just using the configuration option of
	  BR2_PACKAGE_LIBSSP to automatically append "-fstack-protector
	   -fstack-protector-all" into the cflags
```

## components/libuac/Kconfig
```kconfig
config BR2_PACKAGE_LIBUAC
	bool "libuac"
	select BR2_PACKAGE_PREBUILTS_USBDRIVE
	select CONFIG_PIPES
	select BR2_PACKAGE_PTHREAD
	depends on BR2_PACKAGE_LIBUSB
	default n
	help
		userspace library for accessing USB audio (UAC) devices driver

config LIBUAC_NUM_TRANSFER_BUFS
	int "libuac transfer buffer numbers (rang: 2 ~ 32)"
	depends on BR2_PACKAGE_LIBUAC
	range 2 32
	default 20
	help
		set a high number of transfer buffers. This uses a lot of ram, but
		avoids problems with scheduling delays on slow boards causing missed
		transfers. A better approach may be to make the transfer thread FIFO
		scheduled (if we have root).
		Default number of transfer buffers can be overwritten by defining
		this macro.

config LIBUAC_MIC_RINGBUF_SIZE
	int "ringbuffer size for store MICROPHONE stream data (unit:KByets)"
	depends on BR2_PACKAGE_LIBUAC
	range 10 1024
	default 512
	

config BR2_PACKAGE_LIBUAC_EXAMPLES
	bool "build libuac examples"
	depends on BR2_PACKAGE_LIBUAC
	select CONFIG_CMDS_USB
	select CONFIG_CMDS_LIBUAC_EXAMPLES
	help
		examples for showing how to use libuac library
```
